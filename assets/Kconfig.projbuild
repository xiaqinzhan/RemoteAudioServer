## assets/Kconfig.projbuild
```kconfig
menu "Remote Audio Node"

    config RAN_FW_VERSION
        string "Firmware version string (hello.fw)"
        default "2.5.2"
        help
            Firmware version reported to the server in the hello message.
            Must match the server-side protocol expectation.

    config RAN_DIAG_INTERVAL_MS
        int "运行状态心跳间隔 (ms, 0=关闭)"
        default 10000
        range 0 600000
        help
            独立的 diag 任务每隔这么久打一行运行状态（连接、堆、发送统计）。
            设备若出现"日志突然静止/服务端掉线"，靠这行心跳判断 CPU 是否还活着。
            0 = 关闭（正式量产可关）。

    menu "WiFi"
        config RAN_WIFI_SSID
            string "WiFi SSID (编译期默认，仅 NVS 无记录时使用)"
            default "myssid"
            help
                这是【编译期兜底】的 WiFi 名称：只有设备 NVS 里没有任何配网记录时才用它。
                保持默认值 "myssid" 等于"没配"——设备会直接进配网模式，让用户用手机网页配。
                现场配网一次之后，NVS 记录优先生效，改这里不会再影响已配好的设备。
        config RAN_WIFI_PASSWORD
            string "WiFi password"
            default "mypassword"
    endmenu

    menu "WiFi provisioning (网页配网，v2.5 新增)"
        config RAN_PROV_ENABLE
            bool "Enable web provisioning (AP hotspot + config page)"
            default y
            help
                设备没有可用 WiFi 凭据（NVS 无记录且 RAN_WIFI_SSID 仍是 myssid），
                或开机 CONFIG_RAN_PROV_FALLBACK_S 秒内连不上路由器时，开一个开放热点，
                让手机连上后通过网页填写 WiFi 名称和密码。
                进配网不会删除已保存的旧凭据，只有用户保存新网络时才覆盖。
        config RAN_PROV_AP_PREFIX
            string "Hotspot SSID prefix"
            default "RAN"
            help
                热点名形如 RAN-7A44A0（前缀 + 本机 MAC 后 3 字节），方便区分多台设备。
        config RAN_PROV_AP_PASSWORD
            string "Hotspot password (empty = open network)"
            default ""
            help
                留空 = 开放热点（无密码），配网最省事；填空则热点为 WPA2。
        config RAN_PROV_AP_IP
            string "Config page IP (shown to user)"
            default "192.168.4.1"
            help
                配网页地址，也是 DNS 劫持指向的地址；需与 esp_netif 默认 AP 网关一致。
        config RAN_PROV_FALLBACK_S
            int "Auto-enter provisioning after N seconds without IP (0 = off)"
            default 60
            range 0 1800
            help
                有 WiFi 凭据但开机后这么久还没连上，就自动开热点让用户重配。
                60 = 用户要求的"1 分钟后自动转配网"。
        config RAN_PROV_CONNECT_TIMEOUT_S
            int "Wait for IP after user submits credentials (seconds)"
            default 20
            range 5 120
            help
                用户在配网页保存后，设备尝试连接并等待 IP 的时间；超时会把失败原因
                （密码错误 / 找不到网络 / 信号差等）显示回网页，让用户改完重试。
    endmenu

    menu "Server"
        config RAN_SERVER_HOST
            string "remoteAudioServer host (IP or domain)"
            default "remoteaudio.coze.site"
            help
                Host running remoteAudioServer.
                Default points at the Coze-hosted deployment (https://remoteaudio.coze.site).
                For a local LAN server instead, set your PC's IP, e.g. 192.168.1.100.
        config RAN_SERVER_PORT
            int "Server port"
            default 443
            help
                443 = Coze-hosted deployment (wss over TLS).
                8000 = local uvicorn dev server (plain ws).
        config RAN_SERVER_USE_TLS
            bool "Use TLS (wss://)"
            default y
            help
                Enabled: connect with wss:// and validate the server certificate
                against the ESP-IDF CA bundle (requires correct system time -> SNTP).
                Disable only when talking to a plain ws:// server on the LAN.
    endmenu

    menu "Device Identity"
        config RAN_DEVICE_ID_OVERRIDE
            string "Device ID override (empty = auto: esp32- + last 3 MAC bytes)"
            default ""
            help
                Default device ID is "esp32-aabbcc" (last 3 MAC bytes in hex).
                Set a non-empty string here to force a fixed ID, e.g. "esp32-test01".
    endmenu

    menu "Audio and Recording"
        config RAN_VAD_THRESHOLD
            int "VAD energy threshold (16-bit full scale = 32767)"
            default 1200
            range 0 32000
            help
                A 20 ms frame whose RMS exceeds this value is treated as voice.
                Can be changed at runtime via the server set_config command (persisted).
        config RAN_RETENTION_DAYS
            int "Recording retention days (0 = keep forever)"
            default 30
            range 0 3650
        config RAN_SILENCE_TIMEOUT_MS
            int "Silence timeout to auto-stop recording (ms)"
            default 1500
        config RAN_MAX_CLIP_SECONDS
            int "Max duration of one recording file (seconds, auto-split)"
            default 600
        config RAN_PREROLL_FRAMES
            int "Pre-roll buffer frames (20 ms each; default 10 = 200 ms)"
            default 10
        config RAN_VAD_WIN_FRAMES
            int "VAD sliding window frames"
            default 8
    endmenu

    # 说明：这里原本有一个 RAN_ENABLE_I2S_TX（I2S 播放占位通道，默认开），
    # 已经删除。它用 I2S_NUM_1 却复用 I2S0 的 BCLK/WS 引脚，会让录音失去时钟。
    # 本工程固件不实现播放，等真正要加的时候改 I2S_NUM_0 全双工即可。

    menu "OLED (SSD1306, optional)"
        config RAN_ENABLE_OLED
            bool "Enable SSD1306 status display"
            default n
            help
                实战派 S3 板上没有 SSD1306 OLED（I2C SDA/SCL 未接线），
                保持关闭；换到带 OLED 的板子时再打开。
        config RAN_OLED_ADDR
            hex "SSD1306 I2C address"
            default 0x3C
    endmenu

endmenu
```

## firmware/remote_audio_node_mod/main/Kconfig.projbuild
```kconfig
menu "Remote Audio Node"

    config RAN_FW_VERSION
        string "Firmware version string (hello.fw)"
        default "2.2.0"
        help
            Firmware version reported to the server in the hello message.
            Must match the server-side protocol expectation.

    config RAN_DIAG_INTERVAL_MS
        int "运行状态心跳间隔 (ms, 0=关闭)"
        default 10000
        range 0 600000
        help
            独立的 diag 任务每隔这么久打一行运行状态（连接、堆、发送统计）。
            设备若出现"日志突然静止/服务端掉线"，靠这行心跳判断 CPU 是否还活着。
            0 = 关闭（正式量产可关）。

    menu "WiFi"
        config RAN_WIFI_SSID
            string "WiFi SSID"
            default "myssid"
        config RAN_WIFI_PASSWORD
            string "WiFi password"
            default "mypassword"
    endmenu

    menu "Server"
        config RAN_SERVER_HOST
            string "remoteAudioServer host (IP or domain)"
            default "remoteaudio.coze.site"
            help
                Host running remoteAudioServer.
                Default points at the Coze-hosted deployment (https://remoteaudio.coze.site).
                For a local LAN server instead, set your PC's IP, e.g. 192.168.1.100.
        config RAN_SERVER_PORT
            int "Server port"
            default 443
            help
                443 = Coze-hosted deployment (wss over TLS).
                8000 = local uvicorn dev server (plain ws).
        config RAN_SERVER_USE_TLS
            bool "Use TLS (wss://)"
            default y
            help
                Enabled: connect with wss:// and validate the server certificate
                against the ESP-IDF CA bundle (requires correct system time -> SNTP).
                Disable only when talking to a plain ws:// server on the LAN.
    endmenu

    menu "Device Identity"
        config RAN_DEVICE_ID_OVERRIDE
            string "Device ID override (empty = auto: esp32- + last 3 MAC bytes)"
            default ""
            help
                Default device ID is "esp32-aabbcc" (last 3 MAC bytes in hex).
                Set a non-empty string here to force a fixed ID, e.g. "esp32-test01".
    endmenu

    menu "Audio and Recording"
        config RAN_VAD_THRESHOLD
            int "VAD energy threshold (16-bit full scale = 32767)"
            default 1200
            range 0 32000
            help
                A 20 ms frame whose RMS exceeds this value is treated as voice.
                Can be changed at runtime via the server set_config command (persisted).
        config RAN_RETENTION_DAYS
            int "Recording retention days (0 = keep forever)"
            default 30
            range 0 3650
        config RAN_SILENCE_TIMEOUT_MS
            int "Silence timeout to auto-stop recording (ms)"
            default 1500
        config RAN_MAX_CLIP_SECONDS
            int "Max duration of one recording file (seconds, auto-split)"
            default 600
        config RAN_PREROLL_FRAMES
            int "Pre-roll buffer frames (20 ms each; default 10 = 200 ms)"
            default 10
        config RAN_VAD_WIN_FRAMES
            int "VAD sliding window frames"
            default 8
    endmenu

    # 说明：这里原本有一个 RAN_ENABLE_I2S_TX（I2S 播放占位通道，默认开），
    # 已经删除。它用 I2S_NUM_1 却复用 I2S0 的 BCLK/WS 引脚，会让录音失去时钟。
    # 本工程固件不实现播放，等真正要加的时候改 I2S_NUM_0 全双工即可。

    menu "OLED (SSD1306, optional)"
        config RAN_ENABLE_OLED
            bool "Enable SSD1306 status display"
            default n
            help
                实战派 S3 板上没有 SSD1306 OLED（I2C SDA/SCL 未接线），
                保持关闭；换到带 OLED 的板子时再打开。
        config RAN_OLED_ADDR
            hex "SSD1306 I2C address"
            default 0x3C
    endmenu

endmenu
```
