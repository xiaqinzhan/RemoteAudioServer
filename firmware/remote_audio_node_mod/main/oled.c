/**
 * oled.c —— SSD1306 128x64 I2C 最小状态显示
 * IDF v5.2+ 使用新版 i2c_master 驱动；v5.1 使用 legacy i2c.h 接口。
 */
#include "oled.h"
#include "board.h"

#include <string.h>
#include <stdio.h>
#include "freertos/FreeRTOS.h"
#include "freertos/task.h"
#include "esp_log.h"
#include "esp_idf_version.h"
#include "sdkconfig.h"
#include "driver/gpio.h"

#if CONFIG_RAN_ENABLE_OLED

#if ESP_IDF_VERSION >= ESP_IDF_VERSION_VAL(5, 2, 0)
#include "driver/i2c_master.h"
static i2c_master_dev_handle_t s_i2c_dev;
#else
#include "driver/i2c.h"
#define OLED_I2C_FREQ_HZ  400000
#endif

#include "wifi_mgr.h"
#include "ws_client.h"
#include "audio_stream.h"
#include "recorder.h"
#include "device_config.h"
#include "audio_i2s.h"
#include "sd_storage.h"

static const char *TAG = "oled";

/* ---------------- 6x8 ASCII 字库（0x20~0x7F，纵向取模，列扫描） ---------------- */
static const uint8_t font6x8[][6] = {
    {0x00,0x00,0x00,0x00,0x00,0x00}, /* ' ' */
    {0x00,0x00,0x5F,0x00,0x00,0x00}, /* '!' */
    {0x00,0x07,0x00,0x07,0x00,0x00}, /* '"' */
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    {0x10,0x08,0x08,0x10,0x08,0x00}, /* '~' */
};

/* ---------------- SSD1306 底层 ---------------- */
static uint8_t s_fb[128 * 8];   /* 1024B 内部 RAM 帧缓冲 */

static esp_err_t i2c_write(const uint8_t *data, size_t len)
{
#if ESP_IDF_VERSION >= ESP_IDF_VERSION_VAL(5, 2, 0)
    return i2c_master_transmit(s_i2c_dev, data, len, pdMS_TO_TICKS(100));
#else
    return i2c_master_write_to_device(I2C_NUM_0, CONFIG_RAN_OLED_ADDR,
                                      data, len, pdMS_TO_TICKS(100));
#endif
}

static void oled_cmd(uint8_t c)
{
    uint8_t b[2] = {0x00, c};
    i2c_write(b, 2);
}

static void oled_init_hw(void)
{
    const uint8_t init_seq[] = {
        0xAE, 0xD5, 0x80, 0xA8, 0x3F, 0xD3, 0x00, 0x40,
        0x8D, 0x14, 0x20, 0x00, 0xA1, 0xC8, 0xDA, 0x12,
        0x81, 0xCF, 0xD9, 0xF1, 0xDB, 0x40, 0xA4, 0xA6, 0xAF,
    };
    for (size_t i = 0; i < sizeof(init_seq); i++) oled_cmd(init_seq[i]);
}

static void oled_flush(void)
{
    oled_cmd(0x21); oled_cmd(0); oled_cmd(127);
    oled_cmd(0x22); oled_cmd(0); oled_cmd(7);
    uint8_t chunk[1 + 16];
    chunk[0] = 0x40;
    for (int i = 0; i < 1024; i += 16) {
        memcpy(chunk + 1, s_fb + i, 16);
        i2c_write(chunk, sizeof(chunk));
    }
}

static void oled_cls(void) { memset(s_fb, 0, sizeof(s_fb)); }

static void oled_text(int row, int col, const char *s)
{
    int x = col * 6;
    int page = row;
    for (int i = 0; s[i] && x < 126; i++, x += 6) {
        char ch = s[i];
        const uint8_t *glyph;
        if (ch >= 0x20 && ch <= 0x7E) glyph = font6x8[ch - 0x20];
        else glyph = font6x8[0];
        for (int b = 0; b < 6; b++) {
            int idx = page * 128 + x + b;
            if (idx < 1024) s_fb[idx] = glyph[b];
        }
    }
}

/* 画 21 列宽的音量电平条（col 起始） */
static void oled_level_bar(int row, int col, int level_16bit)
{
    int x0 = col * 6;
    int level = level_16bit / 1560;   /* 0..~20 */
    if (level > 20) level = 20;
    for (int i = 0; i < 21; i++) {
        int idx = row * 128 + x0 + i;
        if (idx < 1024) s_fb[idx] = (i < level) ? 0x7F : 0x40;
    }
}

/* ---------------- 显示任务 ---------------- */
static void oled_task(void *arg)
{
    (void)arg;
    oled_init_hw();
    ESP_LOGI(TAG, "SSD1306 初始化完成");

    char line[40];   /* 容纳最长 device_id(31)+IP(15)+状态串，超宽部分屏幕自然截断 */
    for (;;) {
        oled_cls();
        const ran_config_t *cfg = device_config_get();

        /* 行0：设备 ID */
        snprintf(line, sizeof(line), "%s", cfg->device_id);
        oled_text(0, 0, line);

        /* 行1：IP / WiFi 状态 */
        if (wifi_mgr_is_connected()) {
            snprintf(line, sizeof(line), "%s", wifi_mgr_get_ip());
        } else {
            snprintf(line, sizeof(line), "WiFi connecting");
        }
        oled_text(2, 0, line);

        /* 行4：服务端在线状态 + SD 状态 */
        snprintf(line, sizeof(line), "SRV:%s SD:%s",
                 ws_client_is_connected() ? "ON " : "OFF",
                 sd_storage_ready() ? "Y" : "N");
        oled_text(4, 0, line);

        /* 行6：推流/录音状态 + 电平条 */
        snprintf(line, sizeof(line), "%s%s",
                 audio_stream_active() ? "STREAM " : "",
                 recorder_is_recording() ? "REC" :
                 (recorder_is_enabled() ? "RDY" : "STOP"));
        oled_text(6, 0, line);
        if (recorder_is_recording() || audio_stream_active()) {
            oled_level_bar(6, 16, audio_i2s_last_level());
        }

        oled_flush();
        vTaskDelay(pdMS_TO_TICKS(1000));
    }
}

esp_err_t oled_start(void)
{
    /* 引脚未连接（如实战派 S3 无外接 OLED）直接跳过 */
    if (BOARD_OLED_SDA == GPIO_NUM_NC || BOARD_OLED_SCL == GPIO_NUM_NC) {
        ESP_LOGI(TAG, "OLED 引脚未定义（该板型不支持外接 OLED），跳过");
        return ESP_ERR_NOT_FOUND;
    }

#if ESP_IDF_VERSION >= ESP_IDF_VERSION_VAL(5, 2, 0)
    i2c_master_bus_config_t bus_cfg = {
        .i2c_port = BOARD_OLED_I2C_PORT,
        .sda_io_num = BOARD_OLED_SDA,
        .scl_io_num = BOARD_OLED_SCL,
        .clk_source = I2C_CLK_SRC_DEFAULT,
        .glitch_ignore_cnt = 7,
        .flags = { .enable_internal_pullup = true },
    };
    i2c_master_bus_handle_t bus;
    esp_err_t err = i2c_new_master_bus(&bus_cfg, &bus);
    if (err != ESP_OK) {
        ESP_LOGW(TAG, "I2C 主机初始化失败（OLED 不可用）: %s", esp_err_to_name(err));
        return err;
    }
    i2c_device_config_t dev_cfg = {
        .dev_addr_length = I2C_ADDR_BIT_LEN_7,
        .device_address = CONFIG_RAN_OLED_ADDR,
        .scl_speed_hz = 400000,
    };
    err = i2c_master_bus_add_device(bus, &dev_cfg, &s_i2c_dev);
    if (err != ESP_OK) {
        ESP_LOGW(TAG, "I2C 设备添加失败（OLED 不可用）: %s", esp_err_to_name(err));
        return err;
    }
#else
    i2c_config_t conf = {
        .mode = I2C_MODE_MASTER,
        .sda_io_num = BOARD_OLED_SDA,
        .scl_io_num = BOARD_OLED_SCL,
        .sda_pullup_en = GPIO_PULLUP_ENABLE,
        .scl_pullup_en = GPIO_PULLUP_ENABLE,
        .master.clk_speed = OLED_I2C_FREQ_HZ,
    };
    esp_err_t err = i2c_param_config(BOARD_OLED_I2C_PORT, &conf);
    if (err != ESP_OK) { ESP_LOGW(TAG, "I2C 配置失败: %s", esp_err_to_name(err)); return err; }
    err = i2c_driver_install(BOARD_OLED_I2C_PORT, conf.mode, 0, 0, 0);
    if (err != ESP_OK && err != ESP_ERR_INVALID_STATE) {
        ESP_LOGW(TAG, "I2C 驱动安装失败: %s", esp_err_to_name(err));
        return err;
    }
#endif

    /* 探测一次地址，失败则不启动显示任务 */
    uint8_t probe = 0x00;
    if (i2c_write(&probe, 1) != ESP_OK) {
        ESP_LOGW(TAG, "SSD1306 无应答（未接线？），OLED 停用");
        return ESP_ERR_NOT_FOUND;
    }

    if (xTaskCreate(oled_task, "oled", 4096, NULL, 4, NULL) != pdPASS) {
        return ESP_FAIL;
    }
    return ESP_OK;
}

#else  /* !CONFIG_RAN_ENABLE_OLED */

#include "esp_log.h"
static const char *TAG = "oled";
esp_err_t oled_start(void)
{
    ESP_LOGI(TAG, "OLED 已在 menuconfig 中禁用");
    return ESP_OK;
}

#endif /* CONFIG_RAN_ENABLE_OLED */
